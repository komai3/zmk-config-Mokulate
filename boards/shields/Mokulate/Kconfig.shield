## boards/shields/Mokulate/Kconfig.shield
```kconfig
config MOKULATE_LEFT
    def_bool $(shields_list_contains,Mokulate_left)

config MOKULATE_RIGHT
    def_bool $(shields_list_contains,Mokulate_right)

config SHIELD_MOKULATE_DONGLE
    def_bool $(shields_list_contains,Mokulate_dongle)
```

## config/west.yml
```yaml
manifest:
  remotes:
    - name: zmkfirmware
      url-base: https://github.com/zmkfirmware
      
    - name: janpfischer
      url-base: https://github.com/janpfischer
      
    #- name: carrefinho
    #  url-base: https://github.com/carrefinho
    # Additional modules containing boards/shields/custom code can be listed here as well
    # See https://docs.zephyrproject.org/3.2.0/develop/west/manifest.html#projects
  projects:
    - name: zmk
      remote: zmkfirmware
      revision: main
      import: app/west.yml

    - name: zmk-dongle-screen
      remote: janpfischer
      revision: upgrade-4.1
      clone-depth: 1
      
    #- name: prospector-zmk-module
    #  remote: carrefinho
    #  revision: feat/new-status-screens
    
  self:
    path: config
```
